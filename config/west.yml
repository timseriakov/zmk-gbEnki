## config/west.yml
```yaml
manifest:
  remotes:
    - name: zmkfirmware
      url-base: https://github.com/zmkfirmware
    - name: timseriakov
      url-base: https://github.com/
  projects:
    - name: zmk-sqdbruh-fork
      remote: timseriakov
      revision: main
      import: app/west.yml
  self:
    path: config
```
